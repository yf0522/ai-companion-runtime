## firmware/sdkconfig.defaults
```kconfig
CONFIG_WIFI_SSID=""
CONFIG_WIFI_PASS=""
CONFIG_WS_SERVER_URI="wss://device-gateway.example/ws/device/realtime"
CONFIG_WS_AUTH_TOKEN=""
CONFIG_DEVICE_ID=""
CONFIG_COMPANION_REQUIRE_WSS=1
CONFIG_ESP32S3_DEFAULT_CPU_FREQ_240=y
CONFIG_SPIRAM=y
CONFIG_SPIRAM_MODE_OCT=y
```
